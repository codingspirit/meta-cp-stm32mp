## conf/layer.conf
```bitbake
# We have a conf and classes directory, add to BBPATH
BBPATH .= ":${LAYERDIR}"

# We have recipes-* directories, add to BBFILES
BBFILES += "${LAYERDIR}/recipes-*/*/*.bb \
            ${LAYERDIR}/recipes-*/*/*.bbappend"

BBFILE_COLLECTIONS += "meta-cp-stm32mp"
BBFILE_PATTERN_meta-cp-stm32mp = "^${LAYERDIR}/"
BBFILE_PRIORITY_meta-cp-stm32mp = "6"

LAYERDEPENDS_meta-cp-stm32mp = "core"
LAYERSERIES_COMPAT_meta-cp-stm32mp = "thud"
```

## conf/machine/stm32mp1-cp.conf
```bitbake
#@TYPE: Machine
#@NAME: stm32mp1-cp
#@DESCRIPTION: Configuration for STM32MP157A-CP board (Trusted boot and SDcard only)
#@NEEDED_BSPLAYERS: layers/meta-openembedded/meta-oe layers/meta-openembedded/meta-python

include conf/machine/include/st-machine-common-stm32mp.inc

# =========================================================================
# Chip architecture
# =========================================================================
DEFAULTTUNE = "cortexa7thf-neon-vfpv4"
include conf/machine/include/tune-cortexa7.inc

# =========================================================================
# boot scheme
# =========================================================================
BOOTSCHEME_LABELS += "basic"
#BOOTSCHEME_LABELS += "trusted"
#BOOTSCHEME_LABELS += "optee"

# =========================================================================
# boot device
# =========================================================================
# Define the boot device supported
BOOTDEVICE_LABELS += "emmc"
#BOOTDEVICE_LABELS += "nand-4-256"
#BOOTDEVICE_LABELS += "nor-emmc"
#BOOTDEVICE_LABELS += "nor-nand-4-256"
#BOOTDEVICE_LABELS += "nor-sdcard"
BOOTDEVICE_LABELS += "sdcard"

# =========================================================================
# Machine settings
# =========================================================================
# Define list of devicetree per board
#STM32MP_DT_FILES_DK += "stm32mp157a-dk1"
#STM32MP_DT_FILES_DK += "stm32mp157c-dk2"
#STM32MP_DT_FILES_ED += "stm32mp157c-ed1"
STM32MP_DT_FILES_CP += "stm32mp157a-cp"
STM32MP_DEVICETREE_append = " ${STM32MP_DT_FILES_CP} "

# =========================================================================
# Machine features
# =========================================================================
#MACHINE_FEATURES += "bluetooth"
MACHINE_FEATURES += "wifi"
MACHINE_FEATURES += "ethernet"
MACHINE_FEATURES += "${@'gpu' if d.getVar('ACCEPT_EULA_'+d.getVar('MACHINE')) == '1' else ''}"
# Splashscreen enabled
# MACHINE_FEATURES += "splashscreen"

# =========================================================================
# Image
# =========================================================================
# Add ubi FSTYPES to default ones for nand volumes
#IMAGE_FSTYPES += "stmultiubi"

# =========================================================================
# Kernel
# =========================================================================
# Select kernel version
PREFERRED_PROVIDER_virtual/kernel = "linux-stm32mp"
PREFERRED_PROVIDER_u-boot-fw-utils = "libubootenv"

# Define the devicetree for Linux A7 examples
#LINUX_A7_EXAMPLES_DT += "stm32mp157c-dk2-a7-examples"
#LINUX_A7_EXAMPLES_DT += "stm32mp157c-ev1-a7-examples"

# =========================================================================
# flashlayout
# =========================================================================
# Define the config labels to use to generate flashlayout file
FLASHLAYOUT_TYPE_LABELS_emmc += "${STM32MP_DT_FILES_CP}"
FLASHLAYOUT_TYPE_LABELS_sdcard += "${STM32MP_DT_FILES_CP}"

# =========================================================================
# M4 copro
# =========================================================================
# Define the devicetree for M4 example
#CUBE_M4_EXAMPLES_DT += "stm32mp157c-dk2-m4-examples"
#CUBE_M4_EXAMPLES_DT += "stm32mp157c-ev1-m4-examples"

# Define specific board reference to m4projects-stm32mp1.bb
#M4_BOARDS = "STM32MP157C-EV1"

# =========================================================================
# extlinux configuration
# =========================================================================
# Define additional targets to use
UBOOT_EXTLINUX_TARGETS_emmc         += "${@bb.utils.contains('STM32MP_DEVICETREE', 'stm32mp157a-cp', 'mp157a-cp_emmc', '', d)}"
UBOOT_EXTLINUX_TARGETS_emmc-optee   += "${@bb.utils.contains('STM32MP_DEVICETREE', 'stm32mp157a-cp', 'mp157a-cp_emmc-optee', '', d)}"
UBOOT_EXTLINUX_TARGETS_sdcard       += "${@bb.utils.contains('STM32MP_DEVICETREE', 'stm32mp157a-cp', 'mp157a-cp_sdcard', '', d)}"
UBOOT_EXTLINUX_TARGETS_sdcard-optee += "${@bb.utils.contains('STM32MP_DEVICETREE', 'stm32mp157a-cp', 'mp157a-cp_sdcard-optee', '', d)}"
# Define bootprefix for each target
UBOOT_EXTLINUX_BOOTPREFIXES_mp157a-cp_emmc         = "${EXTLINUX_BOOTDEVICE_EMMC}_cp,stm32mp157a-cp_"
UBOOT_EXTLINUX_BOOTPREFIXES_mp157a-cp_emmc-optee   = "${EXTLINUX_BOOTDEVICE_EMMC}_cp,stm32mp157a-cp-optee_"
UBOOT_EXTLINUX_BOOTPREFIXES_mp157a-cp_sdcard       = "${EXTLINUX_BOOTDEVICE_SDCARD}_cp,stm32mp157a-cp_"
UBOOT_EXTLINUX_BOOTPREFIXES_mp157a-cp_sdcard-optee = "${EXTLINUX_BOOTDEVICE_SDCARD}_cp,stm32mp157a-cp-optee_"
# Define labels for each target
UBOOT_EXTLINUX_LABELS_mp157a-cp_emmc         = "stm32mp157a-cp-emmc"
UBOOT_EXTLINUX_LABELS_mp157a-cp_emmc-optee   = "stm32mp157a-cp-emmc-optee"
UBOOT_EXTLINUX_LABELS_mp157a-cp_sdcard       = "stm32mp157a-cp-sdcard"
UBOOT_EXTLINUX_LABELS_mp157a-cp_sdcard-optee = "stm32mp157a-cp-sdcard-optee"
# Define default boot config for each target
UBOOT_EXTLINUX_DEFAULT_LABEL_mp157a-cp_emmc         ?= "stm32mp157a-cp-emmc"
UBOOT_EXTLINUX_DEFAULT_LABEL_mp157a-cp_emmc-optee   ?= "stm32mp157a-cp-emmc-optee"
UBOOT_EXTLINUX_DEFAULT_LABEL_mp157a-cp_sdcard       ?= "stm32mp157a-cp-sdcard"
UBOOT_EXTLINUX_DEFAULT_LABEL_mp157a-cp_sdcard-optee ?= "stm32mp157a-cp-sdcard-optee"
# Define FDT overrides for all labels
UBOOT_EXTLINUX_FDT_stm32mp157a-cp-emmc         = "/stm32mp157a-cp.dtb"
UBOOT_EXTLINUX_FDT_stm32mp157a-cp-emmc-optee   = "/stm32mp157a-cp.dtb"
UBOOT_EXTLINUX_FDT_stm32mp157a-cp-sdcard       = "/stm32mp157a-cp.dtb"
UBOOT_EXTLINUX_FDT_stm32mp157a-cp-sdcard-optee = "/stm32mp157a-cp.dtb"
# Define ROOT overrides for all labels
UBOOT_EXTLINUX_ROOT_stm32mp157a-cp-emmc         = "${EXTLINUX_ROOT_EMMC}"
UBOOT_EXTLINUX_ROOT_stm32mp157a-cp-emmc-optee   = "${EXTLINUX_ROOT_EMMC_OPTEE}"
UBOOT_EXTLINUX_ROOT_stm32mp157a-cp-sdcard       = "${EXTLINUX_ROOT_SDCARD}"
UBOOT_EXTLINUX_ROOT_stm32mp157a-cp-sdcard-optee = "${EXTLINUX_ROOT_SDCARD_OPTEE}"

# =========================================================================
# WIC for sdcard raw image
# =========================================================================
WIC_CREATE_EXTRA_ARGS = "--no-fstab-update"
WKS_FILE_DEPENDS ?= " \
    u-boot-stm32mp \
    tf-a-stm32mp \
    ${@bb.utils.contains('BOOTSCHEME_LABELS', 'optee', 'optee-os-stm32mp', '', d)} \
    st-image-bootfs \
    st-image-vendorfs \
    st-image-userfs \
"
# for generated a WIC file, please uncomment the 2 following lines
#IMAGE_FSTYPES += "wic"
#WKS_FILE += "${@bb.utils.contains('BOOTSCHEME_LABELS', 'optee', 'sdcard-stm32mp157c-ev1-optee-1GB.wks', 'sdcard-stm32mp157c-ev1-trusted-1GB.wks', d)}"
```
